## arch/arm/configs/exynos5420_chagallltetmo_defconfig
```kconfig
# General Chagalllte options
CONFIG_SAMSUNG_GPIO_EXTRA=64
CONFIG_CAMERA_EEPROM=y
CONFIG_CHAGALL=y
CONFIG_CHAGALL_LTE=y
CONFIG_GPS_BCM47531=y
CONFIG_MUIC_FULL_DUMP_ENABLE=y
CONFIG_MUIC_MAX77888_ONESHOT=y
CONFIG_MUIC_MAX77888_SUPPORT_PS_CABLE=y
CONFIG_SIM_DETECT=y
CONFIG_PHY_HSIC_TUNE1=y
CONFIG_PHY_HSIC_TUNE1_REG=0xFC
CONFIG_SEC_MODEM_V2=y
CONFIG_BCM4354=y
CONFIG_KEYBOARD_TC300K=y
CONFIG_TOUCHSCREEN_SYNAPTICS_I2C_DSX=y
CONFIG_INPUT_BOOSTER=y
CONFIG_SENSORS_FP_SPI_NUMBER=1
CONFIG_MFD_MAX77888=y
CONFIG_MFD_SEC_CORE=y
CONFIG_REGULATOR_S2MPS11=y
CONFIG_REGULATOR_S2ABB01=y
CONFIG_MHL_VERSION=0x21
CONFIG_ION_EXYNOS_DRM_VIDEO=210944
CONFIG_ION_EXYNOS_MEMSIZE_SECDMA=128
CONFIG_FB_MIPI_DSIM=y
CONFIG_FB_HW_TRIGGER=y
# CONFIG_FB_S5P_MDNIE is not set
CONFIG_FB_S5P_MDNIE_LITE=y
CONFIG_FB_MIC=y
CONFIG_SUPPORT_WQXGA=y
CONFIG_LCD_PLATFORM=y
CONFIG_LCD_MIPI_S6TNMR7=y
CONFIG_SND_SOC_ADONISUNIV_WM5102=y
# CONFIG_USB_EXYNOS_SS_UDC_SSMODE is not set
CONFIG_FEAT_LED_MAX77888=y
CONFIG_RTC_DRV_SEC=y
CONFIG_MOTOR_DRV_MAX77803=y
CONFIG_SENSORS_FINGERPRINT=y
CONFIG_SENSORS_FINGERPRINT_SYSFS=y
CONFIG_SENSORS_VFS61XX=y
CONFIG_SENSORS_VFS61XX_KO=y
CONFIG_SENSORS=y
CONFIG_SENSORS_BMI055=y
CONFIG_SENSORS_AK09911C=y
CONFIG_SENSORS_CM3323=y
CONFIG_SENSORS_ESD_DEFENCE=y
CONFIG_SENSORS_SX9500=y
CONFIG_SENSORS_SX9500_INIT_TOUCH_THRESHOLD=6000
CONFIG_SENSORS_SX9500_NORMAL_TOUCH_THRESHOLD=10
CONFIG_BATTERY_SWELLING=y
CONFIG_FUELGAUGE_MAX17050=y
CONFIG_FUELGAUGE_MAX17050_COULOMB_COUNTING=y
CONFIG_PREVENT_SOC_JUMP=y
CONFIG_ICE4_TWO_FUNC_INPUT=y

# T-Mobile Specfic Options
CONFIG_BATT_TEMP_TMO=y
CONFIG_VPNCLIENT_SECURITY=y
CONFIG_WLAN_REGION_CODE=402
CONFIG_MHL_SWING_LEVEL_VALUE=0x35
CONFIG_TOUCHSCREEN_CHAGALLLTE_USA=y
CONFIG_TARGET_LOCALE_USA=y
```

## arch/arm/configs/exynos5420_chagallwifi_defconfig
```kconfig
CONFIG_SAMSUNG_GPIO_EXTRA=64
CONFIG_CAMERA_EEPROM=y
CONFIG_CHAGALL=y
CONFIG_CHAGALL_WIFI=y
CONFIG_GPS_BCM47531=y
CONFIG_CMDLINE="console=ttySAC2,115200n8 vmalloc=512M androidboot.console=ttySAC2"
CONFIG_CFG80211_REG_NOT_UPDATED=y
CONFIG_MUIC_FULL_DUMP_ENABLE=y
CONFIG_MUIC_MAX77888_ONESHOT=y
CONFIG_MUIC_MAX77888_SUPPORT_PS_CABLE=y
CONFIG_BCM4354=y
CONFIG_KEYBOARD_TC300K=y
CONFIG_TOUCHSCREEN_SYNAPTICS_I2C_DSX=y
CONFIG_INPUT_BOOSTER=y
CONFIG_SENSORS_FP_SPI_NUMBER=1
CONFIG_MFD_MAX77888=y
CONFIG_MFD_SEC_CORE=y
CONFIG_REGULATOR_S2MPS11=y
CONFIG_REGULATOR_S2ABB01=y
CONFIG_MHL_VERSION=0x21
CONFIG_ION_EXYNOS_DRM_VIDEO=210944
CONFIG_ION_EXYNOS_MEMSIZE_SECDMA=128
CONFIG_FB_MIPI_DSIM=y
CONFIG_FB_HW_TRIGGER=y
# CONFIG_FB_S5P_MDNIE is not set
CONFIG_FB_S5P_MDNIE_LITE=y
CONFIG_FB_MIC=y
CONFIG_SUPPORT_WQXGA=y
CONFIG_LCD_PLATFORM=y
CONFIG_LCD_MIPI_S6TNMR7=y
CONFIG_SND_SOC_ADONISUNIV_WM5102=y
# CONFIG_USB_EXYNOS_SS_UDC_SSMODE is not set
CONFIG_FEAT_LED_MAX77888=y
CONFIG_RTC_DRV_SEC=y
CONFIG_MMC_BKOPS_NODE_UID=1000
CONFIG_MMC_BKOPS_NODE_GID=1001
CONFIG_MOTOR_DRV_MAX77803=y
CONFIG_SENSORS_FINGERPRINT=y
CONFIG_SENSORS_FINGERPRINT_SYSFS=y
CONFIG_SENSORS_VFS61XX=y
CONFIG_SENSORS_VFS61XX_KO=y
CONFIG_SENSORS=y
CONFIG_SENSORS_BMI055=y
CONFIG_SENSORS_AK09911C=y
CONFIG_SENSORS_CM3323=y
CONFIG_SENSORS_ESD_DEFENCE=y
CONFIG_BATTERY_SWELLING=y
CONFIG_FUELGAUGE_MAX17050=y
CONFIG_FUELGAUGE_MAX17050_COULOMB_COUNTING=y
CONFIG_PREVENT_SOC_JUMP=y
CONFIG_ICE4_TWO_FUNC_INPUT=y
```
