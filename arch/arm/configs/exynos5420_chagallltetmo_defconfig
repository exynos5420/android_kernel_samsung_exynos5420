## arch/arm/configs/exynos5420_klimtlte_defconfig
```kconfig
CONFIG_SAMSUNG_GPIO_EXTRA=64
CONFIG_CAMERA_EEPROM=y
CONFIG_KLIMT=y
CONFIG_KLIMT_LTE=y
CONFIG_GPS_BCM47531=y
CONFIG_CMDLINE="console=ttySAC2,115200n8 vmalloc=512M androidboot.console=ttySAC2"
CONFIG_MUIC_FULL_DUMP_ENABLE=y
CONFIG_MUIC_MAX77888_ONESHOT=y
CONFIG_MUIC_MAX77888_SUPPORT_PS_CABLE=y
CONFIG_SIM_DETECT=y
CONFIG_PHY_HSIC_TUNE1=y
CONFIG_PHY_HSIC_TUNE1_REG=0xFC
CONFIG_SEC_MODEM_V2=y
CONFIG_BCM4354=y
CONFIG_KEYBOARD_CYPRESS_TOUCH=y
CONFIG_TOUCHSCREEN_ATMEL_MXT1664T=y
CONFIG_TOUCHSCREEN_SYNAPTICS_I2C_DSX=y
CONFIG_INPUT_BOOSTER=y
CONFIG_SENSORS_FP_SPI_NUMBER=1
CONFIG_MFD_MAX77888=y
CONFIG_MFD_SEC_CORE=y
CONFIG_REGULATOR_S2MPS11=y
CONFIG_REGULATOR_S2ABB01=y
CONFIG_MHL_VERSION=0x21
CONFIG_ION_EXYNOS_DRM_VIDEO=210944
CONFIG_ION_EXYNOS_MEMSIZE_SECDMA=128
CONFIG_FB_MIPI_DSIM=y
CONFIG_FB_HW_TRIGGER=y
# CONFIG_FB_S5P_MDNIE is not set
CONFIG_FB_S5P_MDNIE_LITE=y
CONFIG_FB_MIC=y
CONFIG_SUPPORT_WQXGA=y
CONFIG_LCD_PLATFORM=y
CONFIG_LCD_MIPI_S6E3HA1=y
CONFIG_SND_SOC_ADONISUNIV_WM5102=y
CONFIG_FEAT_LED_MAX77888=y
CONFIG_RTC_DRV_SEC=y
CONFIG_MOTOR_DRV_MAX77803=y
CONFIG_SENSORS_FINGERPRINT=y
CONFIG_SENSORS_FINGERPRINT_SYSFS=y
CONFIG_SENSORS_VFS61XX=y
CONFIG_SENSORS_VFS61XX_KO=y
CONFIG_SENSORS=y
CONFIG_SENSORS_BMI055=y
CONFIG_SENSORS_AK09911C=y
CONFIG_SENSORS_TMD3782=y
CONFIG_SENSORS_SX9500=y
CONFIG_SENSORS_SX9500_INIT_TOUCH_THRESHOLD=8000
CONFIG_SENSORS_SX9500_NORMAL_TOUCH_THRESHOLD=9
CONFIG_BATTERY_SWELLING=y
CONFIG_FUELGAUGE_MAX17050=y
CONFIG_FUELGAUGE_MAX17050_COULOMB_COUNTING=y
CONFIG_PREVENT_SOC_JUMP=y
CONFIG_ICE4_TWO_FUNC_INPUT=y
```

## arch/arm/configs/exynos5420_n1awifi_defconfig
```kconfig
CONFIG_SAMSUNG_GPIO_EXTRA=64
CONFIG_N1A=y
CONFIG_N1A_WIFI=y
CONFIG_GPS_BCM47521=y
CONFIG_SECCOMP=y
CONFIG_CMDLINE="console=ttySAC2,115200n8 vmalloc=512M androidboot.console=ttySAC2 androidboot.hardware=universal5420"
CONFIG_MUIC_MAX77888_SUPPORT_PS_CABLE=y
CONFIG_BCM4339=y
CONFIG_TOUCHSCREEN_ATMEL_MXTS=y
CONFIG_TOUCHSCREEN_ATMEL_MXT1664S=y
CONFIG_INPUT_WACOM=y
CONFIG_EPEN_WACOM_G9PLL=y
CONFIG_MFD_MAX77802=y
CONFIG_MFD_MAX77888=y
CONFIG_REGULATOR_MAX77802=y
CONFIG_ION_EXYNOS_DRM_VIDEO=210944
CONFIG_FB_DBLC_PWM=y
CONFIG_SUPPORT_WQXGA=y
CONFIG_S5P_DP=y
CONFIG_S5P_DP_PSR=y
CONFIG_S5P_DP_ESD_RECOVERY=y
CONFIG_LCD_PLATFORM=y
CONFIG_LCD_LSL122DL01=y
CONFIG_BACKLIGHT_LP855X=y
CONFIG_SND_SOC_ADONISUNIV_WM5102=y
# CONFIG_USB_EXYNOS_SS_UDC_SSMODE is not set
CONFIG_FEAT_LED_MAX77888=y
CONFIG_RTC_DRV_MAX77802=y
CONFIG_MOTOR_DRV_MAX77803=y
CONFIG_SENSORS=y
CONFIG_SENSORS_BMI055=y
CONFIG_SENSORS_AK8963C=y
CONFIG_SENSORS_CM3323=y
CONFIG_SENSORS_SX9500=y
CONFIG_BATTERY_SWELLING=y
CONFIG_FUELGAUGE_MAX17050=y
CONFIG_FUELGAUGE_MAX17050_COULOMB_COUNTING=y
CONFIG_ICE4_TWO_FUNC_INPUT=y
CONFIG_FRAME_WARN=1536
```

## arch/arm/configs/exynos5420_v1awifi_defconfig
```kconfig
CONFIG_SAMSUNG_GPIO_EXTRA=64
CONFIG_V1A=y
CONFIG_V1A_WIFI=y
CONFIG_GPS_BCM47521=y
CONFIG_CMDLINE="console=ttySAC2,115200n8 vmalloc=512M androidboot.console=ttySAC2"
CONFIG_CFG80211_REG_NOT_UPDATED=y
CONFIG_MUIC_MAX77803_SUPPORT_LANHUB=y
CONFIG_MUIC_FULL_DUMP_ENABLE=y
CONFIG_MUIC_MAX77888_ONESHOT=y
CONFIG_MUIC_MAX77888_SUPPORT_PS_CABLE=y
CONFIG_MUIC_MAX77888_ONESHOT=y
CONFIG_BCM4354=y
CONFIG_TOUCHSCREEN_ATMEL_MXTS=y
CONFIG_TOUCHSCREEN_ATMEL_MXT1664S=y
CONFIG_INPUT_WACOM=y
CONFIG_EPEN_WACOM_G9PLL=y
CONFIG_INPUT_BOOSTER=y
CONFIG_MFD_MAX77802=y
CONFIG_MFD_MAX77888=y
CONFIG_REGULATOR_MAX77802=y
CONFIG_MHL_VERSION=0x21
CONFIG_ION_EXYNOS_DRM_VIDEO=210944
CONFIG_ION_EXYNOS_MEMSIZE_SECDMA=128
CONFIG_FB_DBLC_PWM=y
CONFIG_SUPPORT_WQXGA=y
CONFIG_S5P_DP=y
CONFIG_S5P_DP_PSR=y
CONFIG_S5P_DP_ESD_RECOVERY=y
CONFIG_LCD_PLATFORM=y
CONFIG_LCD_LSL122DL01=y
CONFIG_BACKLIGHT_LP855X=y
CONFIG_SND_SOC_ADONISUNIV_WM5102=y
CONFIG_MMC_BKOPS_NODE_UID=1000
CONFIG_MMC_BKOPS_NODE_GID=1001
CONFIG_FEAT_LED_MAX77888=y
CONFIG_RTC_DRV_MAX77802=y
CONFIG_HAPTIC_ISA1200=y
CONFIG_HAPTIC_ISA1400=y
CONFIG_SENSORS=y
CONFIG_SENSORS_BMI055=y
CONFIG_SENSORS_AK8963C=y
CONFIG_SENSORS_CM3323=y
CONFIG_FUELGAUGE_MAX17050=y
CONFIG_FUELGAUGE_MAX17050_COULOMB_COUNTING=y
CONFIG_PREVENT_SOC_JUMP=y
CONFIG_ICE4_TWO_FUNC_INPUT=y
# CONFIG_SECURITY_SELINUX_DEVELOP is not set
```

## drivers/gpu/arm/mali400/Kconfig
```kconfig
if MACH_SMDK4412

menuconfig MALI_400MP_UMP
	tristate "Mali-400 support"
	default y
	depends on MACH_SMDK4412
	help
	  Enable this option to build support for the ARM Mali-400 GPU.
	  This enables MALI and UMP integration in the multimedia device driver

choice
depends on MALI_400MP_UMP
prompt "MALI MEMORY OPTION"
default MALI_OSMEM_ONLY
config MALI_DED_ONLY
	bool "mali dedicated memory only"
	help
	  This enables MALI dedicated memory only option
config MALI_DED_MMU
	bool "mali dedicated memory with mmu enable"
	help
	  This enables MALI dedicated memory with mmu enable option
config MALI_OSMEM_ONLY
	bool "mali OS memory only"
	help
	  This enables MALI OS memory only option
config MALI_DED_OSMEM
	bool "mali dedicated memory and OS memory"
	help
	  This enables MALI dedicated memory and OS memory option
endchoice

config MALI_MEM_SIZE
	int "Dedicated Memory Size"
	depends on MALI_400MP_UMP && (MALI_DED_ONLY || MALI_DED_MMU || MALI_DED_OSMEM)
	default "128"
	help
	  This value is dedicated memory size of Mali GPU(unit is MByte).

# For UMP
config UMP_VCM_ALLOC
	bool "Enable ump-vcm(virtual contiguous memory) memory"
	depends on MALI_400MP_UMP && VCM
	default y
	help
	  Use VCM(virtual-contiguous-memory) to allocate physical memory.

choice
depends on MALI_400MP_UMP
prompt "UMP MEMEMORY OPTION"
default UMP_OSMEM_ONLY
config UMP_DED_ONLY
	bool "ump dedicated memory only"
	help
	  This enables UMP dedicated memory only option
config UMP_OSMEM_ONLY
	bool "ump OS memory only"
	help
	  This enables UMP OS memory only option
config UMP_VCM_ONLY
	bool "ump VCM memory"
	help
	  This enables UMP VCM memory only option
endchoice

config UMP_MEM_SIZE
	int "UMP Memory Size"
	depends on MALI_400MP_UMP
	default "512"
	help
	  This value is dedicated memory size of UMP (unit is MByte).

choice
	depends on MALI_400MP_UMP
	prompt "Select MALI Version"
	default MALI_UMP_R3P0
config MALI_UMP_R2P4
	bool "Uses the R2P4 kernel module"
	help
	  This uses the r2p4 as a UMP and MALI kernel module
config MALI_UMP_R3P0
	bool "Uses the R3P0 kernel module"
	help
	  This uses the r3p0 as a UMP and MALI kernel module
endchoice

# For MALI_UMP_DEBUG
config VIDEO_MALI400MP_UMP_DEBUG
	bool "Enables mali and ump debug messages"
	depends on MALI_400MP_UMP
	default n
	help
	  This enables Mali and UMP driver debug messages.

config VIDEO_MALI400MP_STREAMLINE_PROFILING
	bool "Enables mali streamline profiling"
	depends on MALI_400MP_UMP
	default n
	help
	  This enables Mali streamline profiling.

config VIDEO_MALI400MP_DVFS
	bool "Enables DVFS"
	depends on MALI_400MP_UMP && PM
	default y
	help
	  This enables Mali driver DVFS.
endif

config VIDEO_SAMSUNG
	bool "Samsung Multimedia Devices"
	depends on VIDEO_CAPTURE_DRIVERS && VIDEO_V4L2
	select VIDEO_FIXED_MINOR_RANGES
	default n
	help
	  This is a representative video4linux configuration for Samsung multimedia devices.

config VIDEO_SAMSUNG_V4L2
	bool "V4L2 API for digital camera to be contributed by samsung"
	depends on VIDEO_DEV && VIDEO_SAMSUNG
	default n
	help
	  This feature is for new V4L2 APIs all about digital camera
```

## drivers/gpu/arm/t6xx/Kconfig
```kconfig
#
# (C) COPYRIGHT 2012-2013 ARM Limited. All rights reserved.
#
# This program is free software and is provided to you under the terms of the
# GNU General Public License version 2 as published by the Free Software
# Foundation, and any use by you of this program is subject to the terms
# of such GNU licence.
#
# A copy of the licence is included with the program, and can also be obtained
# from Free Software Foundation, Inc., 51 Franklin Street, Fifth Floor,
# Boston, MA  02110-1301, USA.
#
#


menuconfig MALI_T6XX
	tristate "Mali-T6XX driver support"
	default y
	help
	  Enable this option to build support for the ARM Mali-T6xx GPU.

	  To compile this driver as a module, choose M here:
	  this will generate a single module, called mali_kbase.

choice
	prompt "version Configuration"
	depends on MALI_T6XX
	default MALI_T6XX_R7P0  if DDK_VERSION_OS = "m"
	default MALI_T6XX_R15P0 if DDK_VERSION_OS = "n"
	help
	  Select the gpu support version.

config MALI_T6XX_R7P0 
	depends on MALI_T6XX
	bool "t6xx r7p0 driver"

config MALI_T6XX_R15P0
	depends on MALI_T6XX
 	bool "t6xx r15p0 driver"

endchoice

if MALI_T6XX_R7P0
	source "drivers/gpu/arm/t6xx/r7p0/Kconfig"
endif

if MALI_T6XX_R15P0
	source "drivers/gpu/arm/t6xx/r15p0/Kconfig"
endif
```

## drivers/gpu/arm/t6xx/kbase/src/platform/arndale/Kconfig
```kconfig
#
# (C) COPYRIGHT 2013 ARM Limited. All rights reserved.
#
# This program is free software and is provided to you under the terms of the GNU General Public License version 2
# as published by the Free Software Foundation, and any use by you of this program is subject to the terms of such GNU licence.
#
# A copy of the licence is included with the program, and can also be obtained from Free Software
# Foundation, Inc., 51 Franklin Street, Fifth Floor, Boston, MA  02110-1301, USA.
#
#
if MALI_PLATFORM_THIRDPARTY_NAME = "arndale"

menu "Arndale options"
    depends on MALI_T6XX && MALI_EXPERT && MALI_PLATFORM_THIRDPARTY
    
config MALI_T6XX_DVFS_LIMIT_450
    bool "Enable dvfs limit to 450 MHz"
    depends on MALI_T6XX_DEBUG_SYS && MALI_T6XX_DVFS && MALI_EXPERT
    default n
    help
        Choose this option to force DVFS limit to 450 MHz maximum.
        
endmenu
endif
```

## drivers/gud/Kconfig
```kconfig
#
# MobiCore configuration
#
#if SOC_EXYNOS3470
#source "drivers/gud/gud-exynos3470/Kconfig"
#source "drivers/gud/sec-os-ctrl/Kconfig"
#endif

#if SOC_EXYNOS3472
#source "drivers/gud/gud-exynos3472/Kconfig"
#source "drivers/gud/sec-os-ctrl/Kconfig"
#endif

#if SOC_EXYNOS5260
#source "drivers/gud/gud-exynos5260/Kconfig"
#endif

#if SOC_EXYNOS5410
#source "drivers/gud/gud-exynos5410/Kconfig"
#endif

if SOC_EXYNOS5420
source "drivers/gud/gud-exynos5420/Kconfig"
endif

#if SOC_EXYNOS4415
#source "drivers/gud/gud-exynos4415/Kconfig"
#source "drivers/gud/sec-os-ctrl/Kconfig"
#endif
```

## drivers/ice4_fpga/Kconfig
```kconfig
#
# ICE4_FPGA
#
menu "BARCODE_EMUL and IRDA FPGA"

config ICE4_FPGA
	tristate "FPGA chip for Barcode emulator and IR LED control"
	default n
	help
	  Lattice FPGA can support both Barcode emulator and IR LED controller.
	  The configuration is just BARCODE_EMUL, but it contains IRDA feature, too.
	  To compile this driver as a module, choose M here.
	  If unsure, say N.

config BARCODE_EMUL_ICE4
	tristate "this feature allows Barcode emulator"
	depends on ICE4_FPGA
	default n
	help
	  This is a driver for barcode emulator driver based on Lattice chip.
	  Lattice FPGA can support Barcode emulator.
	  To compile this driver as a module, choose M here.
	  If unsure, say N.

config IR_REMOCON_FPGA
	tristate "this feature allows IR LED"
	depends on ICE4_FPGA
	default n
	help
	  This is a driver for IR LED driver based on Lattice chip.
	  Lattice FPGA can support IR LED.
	  To compile this driver as a module, choose M here.
	  If unsure, say N.

config ICE4_TWO_FUNC_INPUT
	tristate "this feature allows spi for i2c"
	depends on ICE4_FPGA
	default n
	help
	  This is a configuration for input port setting.
	  Lattice FPGA can support this configuration
	  To compile this driver as a module, choose M here.
	  If unsure, say N.

endmenu
```

## drivers/input/touchscreen/synaptics_dsx/Kconfig
```kconfig
#
# SYNAPTICS TOUCH driver configuration
#

config TOUCHSCREEN_SYNAPTICS_I2C_DSX
	tristate "Synaptics DSX I2C touchscreen"
	depends on I2C
	help
	  Say Y here if you have a Synaptics DSX I2C touchscreen
	  connected to your system.

	  If unsure, say N.

	  To compile this driver as a module, choose M here: the
	  module will be called synaptics_rmi4_i2c.
```

## drivers/media/video/mhl/Kconfig
```kconfig
#
# mhl drivers configuration
#

menu "Mhl(sii8240) device support"


config SAMSUNG_MHL_8240
        bool "Enable Sii8240 MHL Chip Driver"
        default n
        ---help---
          support Sii9244 MHL Chip Driver

config MHL_VERSION
        hex "Number of MHL Version"
        default 0x20
        ---help---
          MHL Version
		  For example, those device compliant
		  with MHL Specification version 2.0
		  shell set this MHL_VERSION to 0x20

config MHL_SWING_LEVEL_VALUE
        hex "MHL swing level"
        default 0x25
        ---help---
          MHL swing level
                support for tuning MHL swing level
                0 1 2 bit data 3 4 5 bit clk
                0x25 is default value 100101
endmenu
```

## drivers/misc/mdm_if/Kconfig
```kconfig
comment "Qualcomm Modem Feature"
config QC_MODEM
	bool "Qualcomm modem support"
	default n

config MSM_SUBSYSTEM_RESTART
	bool "QC Modem restart handler"
	default n

config QC_MODEM_MDM9X15
	bool "support QC mdm9x15 modem"
	default n

config MDM_HSIC_PM
	bool "support QC mdm9x15 PM over HSIC"
	default n

config EMI_ERROR_RECOVERY
	bool "unsuspected emi error recovery on HUB"
	default n

config SIM_DETECT
	bool "support sim detect"
	default n

if QC_MODEM
choice
	prompt "QC MODEM CONFIG"
	depends on QC_MODEM
	default QC_MODEM_M3

config QC_MODEM_M3
	bool "M3 support QMI inteface over HSIC"
	select MODEM_SUPPORT_QMI_INTERFACE
	select MSM_SUBSYSTEM_RESTART
	select USB_QCOM_DIAG_BRIDGE
	select USB_QCOM_MDM_BRIDGE
	select QC_MODEM_MDM9X15
	select MSM_RMNET_USB
	select DIAG_CHAR
	select MDM_HSIC_PM
	select USB_QCOM_KS_BRIDGE
	select USB_SERIAL_CSVT
#	select USB_SERIAL_QUALCOMM

endchoice

config EHCI_MODEM_PORTNUM
	int "EHCI port number of modem connection"
	default 2

endif
```

## drivers/misc/modem_if/Kconfig
```kconfig
menuconfig SEC_MODEM_IF
	bool "Samsung Mobile Modem Interface"
	default n
	---help---
	  Samsung Modem Interface Driver.

if SEC_MODEM_IF

config SEC_MODEM_XMM6360
	bool "XMM6360 feature"
	default n
	select UMTS_MODEM_XMM6360
	select LINK_DEVICE_HSIC
	select EHCI_IRQ_DISTRIBUTION

config SEC_MODEM_XMM6262
	bool "M0 with xmm6262"
	default y
	select UMTS_MODEM_XMM6262
	select LINK_DEVICE_HSIC

menu "Configuration Description"
config UMTS_MODEM_XMM6360
	bool "modem chip : IMC XMM6360"
	default n

config UMTS_MODEM_XMM6262
	bool "modem chip : IMC XMM6262"
	default n

config CDMA_MODEM_CBP71
	bool "modem chip : VIA CBP7.1"
	default n

config CDMA_MODEM_CBP72
	bool "modem chip : VIA CBP7.2"
	default n

config CDMA_MODEM_CBP82
	bool "modem chip : VIA CBP8.2"
	default n

config LTE_MODEM_CMC221
	bool "modem chip : SEC CMC221"
	default n

config UMTS_MODEM_SS222
	bool "modem chip : SEC SS222"
	default n

config CDMA_MODEM_MDM6600
	bool "modem chip : QC MDM6600"
	default n

config TDSCDMA_MODEM_SPRD8803
	bool "modem chip : SPRD SC8803"
	default n

config GSM_MODEM_ESC6270
	bool "modem chip : QC ESC6270"
	default n

config CDMA_MODEM_QSC6085
	bool "modem chip : Qualcomm QSC6085"
	default n

config LINK_DEVICE_MIPI
	bool "modem driver link device MIPI-HSI"
	default n

config LINK_DEVICE_DPRAM
	bool "modem driver link device DPRAM"
	default n

config LINK_DEVICE_PLD
	bool "modem driver link device PLD"
	default n

config LINK_DEVICE_USB
	bool "modem driver link device USB"
	default n

config LINK_DEVICE_HSIC
	bool "modem driver link device HSIC"
	default n

config LINK_DEVICE_C2C
	bool "modem driver link device C2C"
	default n

config LINK_DEVICE_SPI
	bool "modem driver link device SPI"
	default n

config BOOT_DEVICE_SPI
	bool "modem driver boot device SPI"
	default n

config WORKQUEUE_FRONT
	bool "IPC: SPI workqueue front"
	default n

config SIM_DETECT
	bool "SIM_DETECT pin"
	default n

config SIM_SLOT_SWITCH
	bool "SIM_SLOT_SWITCH"
	default n

if LINK_DEVICE_HSIC
config PHY_HSIC_TUNE1
	bool "Adjust S.LSI HSICPHYTUNE1 register"
	default n
endif

if PHY_HSIC_TUNE1
config PHY_HSIC_TUNE1_REG
	hex "EHCI phy hsic tune"
	default 0x3A
endif

endmenu
endif
```
