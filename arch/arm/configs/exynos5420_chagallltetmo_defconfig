## drivers/misc/modem_v2/Kconfig
```kconfig
menuconfig SEC_MODEM_V2
	bool "Samsung Mobile Modem Interface V2"
	default n
	---help---
	  Samsung Modem Interface Drivers for
	  SAMSUNG IPC models
	  And you can select the modem chipset
	  and interface link type.

if SEC_MODEM_V2

config SEC_MODEM_XMM6360
	bool "XMM6360 feature"
	default y
	select UMTS_MODEM_XMM6360
	select LINK_DEVICE_HSIC
	select EHCI_IRQ_DISTRIBUTION

config SEC_MODEM_XMM6262
	bool "XMM6262 feature"
	default n
	select UMTS_MODEM_XMM6262
	select LINK_DEVICE_HSIC

menu "Configuration Description"
config UMTS_MODEM_XMM6260
	bool "modem chip : IMC XMM6260"
	default n

config UMTS_MODEM_XMM6262
	bool "modem chip : IMC XMM6262"
	default n

config UMTS_MODEM_XMM6360
	bool "modem chip : IMC XMM6360"
	default n

config CDMA_MODEM_MDM6600
	bool "modem chip : QC MDM6600"
	default n

config GSM_MODEM_ESC6270
	bool "modem chip : QC ESC6270"
	default n

config LINK_DEVICE_HSIC
	bool "modem driver link device HSIC"
	default n

config LINK_DEVICE_PLD
	bool "modem driver link device PLD"
	default n

config LINK_ETHERNET
	bool "SIPC USB raw ehternet patcket"
	select MII
	default n

config SIM_DETECT
	bool "SIM_DETECT pin"
	default n

config SIM_SLOT_SWITCH
	bool "SIM_SLOT_SWITCH"
	default n

config EHCI_IRQ_DISTRIBUTION
	bool "Distribute ehci irq"
	default n

if LINK_DEVICE_HSIC
config EHCI_MODEM_PORTNUM
	int "EHCI port number of modem connection"
	default 2

config PHY_HSIC_TUNE1
	bool "Adjust S.LSI HSICPHYTUNE1 register"
	default n
endif

if PHY_HSIC_TUNE1
config PHY_HSIC_TUNE1_REG
	hex "EHCI phy hsic tune"
	default 0x3A
endif

endmenu
endif
```

## drivers/motor/Kconfig
```kconfig
config MOTOR_DRV_MAX77803
	tristate "Maxim MAX77803 motor"
	default n
	depends on MFD_MAX77803 || MFD_MAX77888
	help
	  If you say yes here you will get support for the
	  motor of Maxim MAX77803 PMIC.

config HAPTIC_ISA1200
	tristate "ISA1200 motor"
	default n
	depends on I2C
	help
	  Say Y to enalbe the ISA1200 IC.
```

## drivers/sensors/Kconfig
```kconfig
#
# Sensor  drivers configuration
#
menuconfig SENSORS
	bool "Sensor devices"
	help
	  Say Y here, and a list of sensors drivers will be displayed.
	  Everything that didn't fit into the other categories is here. This option
	  doesn't affect the kernel.

	  If unsure, say Y.

config SENSORS_BMI055
	tristate "BMI055 Combo Sensor Driver"
	depends on I2C
	default n
	help
	  If you say yes here you get support for Bosch-Sensortec's
	  BMI055 Acceleration & Gyroscope Sensor.

config SENSORS_BMI058
	tristate "BMI058 Combo Sensor Driver"
	depends on I2C
	default n
	help
	  If you say yes here you get support for Bosch-Sensortec's
	  BMI058 Acceleration & Gyroscope Sensor.

config SENSORS_AK8963C
	tristate "AK8963C compass support"
	default n
	depends on I2C
	help
	  If you say yes here you get support for Asahi Kasei's
	  orientation sensor AK8963.

config SENSORS_AK09911C
	tristate "AK09911C compass support"
	default n
	depends on I2C
	help
	  If you say yes here you get support for Asahi Kasei's
	  orientation sensor AK09911C.

config SENSORS_CM3323
	depends on I2C
	tristate "CM3323 driver"
	default n
	help
	  Say Y here if you use cm3323.
	  This option enables RGB sensors using
	  Capella cm3323 device driver.

	  Say N here if you do not use cm3323.

config SENSORS_TMD3782
	depends on I2C
	tristate "TMD3782 driver"
	default n
	help
	  Say Y here if you use tmd3782.
	  This option enables light & proximity sensors using
	  AMS tmd3782 device driver.

	  Say N here if you do not use tmd3782.

config SENSORS_ESD_DEFENCE
	depends on I2C
	tristate "ESD Defence"
	default n
	help
	  Say Y here if you use ESD defence.
	  This option enables ESD defence code.

	  Say N here if you do not use ESD defence.

config SENSORS_SX9500
	depends on I2C
	tristate "SX9500 driver"
	default n
	help
	  Say Y here if you use sx9500.
	  This option enables grip sensors using
	  SemTech sx9500 device driver.

	  Say N here if you do not use sx9500.

config SENSORS_SX9500_INIT_TOUCH_THRESHOLD
	int "SX9500 Grip sensor threshold for init touch"
	depends on SENSORS_SX9500
	default "3000"
	help
	  This value is the standard of init touch using
	  SemTech sx9500 device driver.

config SENSORS_SX9500_NORMAL_TOUCH_THRESHOLD
	int "SX9500 Grip sensor threshold for normal touch"
	depends on SENSORS_SX9500
	default "17"
	help
	  This value is the standard of normal touch using
	  SemTech sx9500 device driver.
```

## sound/soc/codecs/ymu831/Kconfig
```kconfig
config SND_SOC_YAMAHA_YMU831
	tristate
	depends on SND_SOC && SPI
	select SND_HWDEP

config SND_SOC_YAMAHA_YMU831_DEBUG
	bool
	select SND_DEBUG
	depends on SND_SOC_YAMAHA_YMU831
```
